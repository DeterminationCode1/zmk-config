#include <behaviors.dtsi>
#include <behaviors/num_word.dtsi> // requires auto-layer module
#include <dt-bindings/zmk/keys.h>
#ifdef CONFIG_WIRELESS
#include <dt-bindings/zmk/bt.h>
#define _BT_SEL_KEYS_                                                          \
  &bt BT_SEL 0 & bt BT_SEL 1 & bt BT_SEL 2 & bt BT_SEL 3 & bt BT_CLR
#else
#define _BT_SEL_KEYS_ &trans & trans & trans & trans &trans
#endif

#include "zmk-helpers/helper.h"
#include "zmk-helpers/unicode-chars/german.dtsi"
#include "zmk-helpers/unicode-chars/greek.dtsi"

#define DEF 0
#define NAV 1
#define FN 2
#define NUM 3
#define SYS 4
#define UC 5
#define MOUSE 6

#define XXX &none
#define ___ &trans

/* Global settings */

#define QUICK_TAP_MS 175

&sk {                           // sticky-key config
  release - after - ms = <900>; // release after 0.9s
  quick - release;              // no double capitalization when rolling keys
};

&sl {                 // sticky-layer config
  ignore - modifiers; // allow chording sticky mods & layers
};

&lt { // layer-tap config
  flavor = "balanced";
  tapping - term - ms = <200>;
  quick - tap - ms = <QUICK_TAP_MS>;
};

&leader { // leader-key config
  timeout - ms = <650>;
};

/* Homerow mods */

#define KEYS_L                                                                 \
  LT0 LT1 LT2 LT3 LT4 LM0 LM1 LM2 LM3 LM4 LB0 LB1 LB2 LB3 LB4 // left hand
#define KEYS_R                                                                 \
  RT0 RT1 RT2 RT3 RT4 RM0 RM1 RM2 RM3 RM4 RB0 RB1 RB2 RB3 RB4 // right hand
#ifndef LH2
#define THUMBS LH1 LH0 RH0 RH1 // thumbs on 34 keys
#else
#define THUMBS LH2 LH1 LH0 RH0 RH1 RH2 // thumbs on 36+ keys
#endif

// Urob readme.md: idle time shold be around: As a rule of thumb, you want to
// set it to at least 10500/x where x is your (relaxed) WPM for English prose.
// reqire-prior-idle-ms=//Urob's original value was 150.
#define MAKE_HRM(NAME, HOLD, TAP, TRIGGER_POS)                                 \
  ZMK_HOLD_TAP(NAME, flavor = "balanced"; tapping - term - ms = <280>;         \
               quick - tap - ms = <QUICK_TAP_MS>;                              \
               require - prior - idle - ms = <200>; bindings = <HOLD>, <TAP>;  \
               hold - trigger - key - positions = <TRIGGER_POS>;               \
               hold - trigger - on - release;)
MAKE_HRM(hml, &kp, &kp, KEYS_R THUMBS) // left-hand HRMs
MAKE_HRM(hmr, &kp, &kp, KEYS_L THUMBS) // right-hand HRMs

// HRM combo hack - workaround for lack of tap-only combos (ZMK issue #544)
#define ZMK_COMBO_8(NAME, TAP, KEYPOS, LAYERS, COMBO_TERM, COMBO_IDLE, HOLD,   \
                    SIDE)                                                      \
  MAKE_HRM(hm_combo_##NAME, &kp, TAP, SIDE THUMBS)                             \
  ZMK_COMBO_6(NAME, &hm_combo_##NAME HOLD 0, KEYPOS, LAYERS, COMBO_TERM,       \
              COMBO_IDLE)

/* Combos, leader key sequences, mouse emulation */

#include "combos.dtsi" // must be sources after HRM-combo hack
#include "extra_keys.h"
#include "leader.dtsi"
#include "mouse.dtsi"

/* Nav cluster */

// long-tap action on hold, short-tap action on all interrupts
#define MT_CORE                                                                \
  flavor = "tap-preferred";                                                    \
  tapping - term - ms = <220>;                                                 \
  quick - tap - ms = <220>;                                                    \
  hold - trigger - key - positions = <0>;

&mt{MT_CORE};
ZMK_HOLD_TAP(mt_home, bindings = <&masked_home>, <&kp>; MT_CORE)
ZMK_HOLD_TAP(mt_end, bindings = <&masked_end>, <&kp>; MT_CORE)

#define NAV_LEFT &mt_home 0 LEFT  // tap: left  | long-tap: beginning of line
#define NAV_RIGHT &mt_end 0 RIGHT // tap: right | long-tap: end       of line
#define NAV_UP &mt LC(HOME) UP // tap: up    | long-tap: beginning of document
#define NAV_DOWN                                                               \
  &mt LC(END) DOWN // tap: down  | long-tap: end       of document
#define NAV_BSPC                                                               \
  &mt LA(BSPC) BSPC // tap: bspc  | long-tap: delete word backward // !Me:
                    // windows uses LCtr instead of LOption
#define NAV_DEL                                                                \
  &mt LA(DEL) DEL // tap: del   | long-tap: delete word forward // !Me: windows
                  // uses LCtr instead of LOption

// mask CTRL when holding left/right to avoid accidental jumps to beginning/end
// of document
#define MASK_MODS(NAME, MODS, BINDING)                                         \
  ZMK_MOD_MORPH(NAME, bindings = <BINDING>, <BINDING>; mods = <MODS>;)
MASK_MODS(masked_home, (MOD_LCTL), &kp HOME)
MASK_MODS(masked_end, (MOD_LCTL), &kp END)

/* Caps-word, num-word and smart-mouse */

// tap: sticky-shift | shift + tap/ double-tap: caps-word | hold: shift
ZMK_MOD_MORPH(smart_shft, bindings = <&sk LSHFT>, <&caps_word>;
              mods = <(MOD_LSFT)>;)
&caps_word { // mods deactivate caps-word, requires PR #1451
  / delete -property / ignore - modifiers;
};

// tap: num-word | double-tap: sticky num-layer | hold: num-layer
#define SMART_NUM &smart_num NUM 0
ZMK_HOLD_TAP(smart_num, flavor = "balanced"; tapping - term - ms = <200>;
             quick - tap - ms = <QUICK_TAP_MS>; bindings = <&mo>, <&num_dance>;)
ZMK_TAP_DANCE(num_dance, tapping - term - ms = <200>;
              bindings = <&num_word NUM>,
              <&sl NUM>; // reverse this for sticky-num on single tap
)

// smart-mouse, requires PR #1366
ZMK_TRI_STATE(smart_mouse, bindings = <&tog MOUSE>, <&none>, <&tog MOUSE>;
              ignored - key - positions =
                  <LT1 LT3 RT0 RT1 RT2 RT3 RT4 RM1 RM2 RM3 RB1 RB2 RB3 RH0 RH1>;
              ignored - layers = <MOUSE>;)

/* Custom behaviors */

// Alt+Tab swapper, requires PR #1366
ZMK_TRI_STATE(swapper, bindings = <&kt LCMD>, <&kp TAB>, <&kt LCMD>;
              ignored - key - positions = <LT2>;)

// Sticky layer + sticky shift (workaround for issue #1421)
ZMK_STICKY_KEY(sls, release - after - ms = <1000>; bindings = <&uc_shift>;
               ignore - modifiers;)
ZMK_MACRO(uc_shift, wait - ms = <0>; tap - ms = <1>;
          bindings = < &macro_press & mo UC & kp LSHFT >,
          <&macro_pause_for_release>, <&macro_release & mo UC & kp LSHFT>;)

// reuse basic mod-morph scheme
#define SIMPLE_MORPH(NAME, MOD, BINDING1, BINDING2)                            \
  ZMK_MOD_MORPH(NAME, mods = <(MOD_L##MOD | MOD_R##MOD)>;                      \
                bindings = <BINDING1>, <BINDING2>;)

// tap: comma | shift + tap: semicolon | ctrl + shift + tap: <
SIMPLE_MORPH(comma_morph, SFT, &kp COMMA, &comma_inner_morph)
SIMPLE_MORPH(comma_inner_morph, CTL, &kp SEMICOLON, &kp LESS_THAN)

// tap: dot | shift + tap: colon | ctrl + shift + tap: >
SIMPLE_MORPH(dot_morph, SFT, &kp DOT, &dot_inner_morph)
SIMPLE_MORPH(dot_inner_morph, CTL, &kp COLON, &kp GREATER_THAN)

// tap: qmark | shift + tap: excl
SIMPLE_MORPH(qexcl, SFT, &kp QMARK, &kp EXCL)

// tap: left/right parenthesis | shft + tap: less-than/greater-than
SIMPLE_MORPH(lpar_lt, SFT, &kp LPAR, &kp LT)
SIMPLE_MORPH(rpar_gt, SFT, &kp RPAR, &kp GT)

// tap: space | shift + tap: dot -> space -> sticky shift | hold: activate layer
ZMK_HOLD_TAP(lt_spc, flavor = "balanced"; tapping - term - ms = <200>;
             quick - tap - ms = <QUICK_TAP_MS>; bindings = <&mo>, <&spc_morph>;)
SIMPLE_MORPH(spc_morph, SFT, &kp SPACE, &dot_spc)
ZMK_MACRO(dot_spc, wait - ms = <0>; tap - ms = <5>;
          bindings = < &kp DOT & kp SPACE & sk LSHFT > ;)

// tap: backspace | lshft + tap: delete | rshft + tap: shift-delete
ZMK_MOD_MORPH(bs_del, bindings = <&kp BSPC>, <&kp DEL>;
              mods = <(MOD_LSFT | MOD_RSFT)>; keep - mods = <MOD_RSFT>;)

// me; originally used `INS` for copy
// tap: copy | double-tap: cut
ZMK_TAP_DANCE(copy_cut, tapping - term - ms = <200>;
              bindings = <&kp LG(C)>, <&kp LG(X)>;)

// // Windows sleep key. Not neede on Mac.
// ZMK_MACRO(win_sleep,
//     wait-ms = <500>;
//     tap-ms = <50>;
//     bindings = <&kp LG(X) &kp U &kp S>;
// )

// Sticky shift + leader
ZMK_MACRO(leader_sft, bindings = < &sk LSHFT & leader > ;)

// misc aliases
#define CANCEL &kp K_CANCEL // cancel caps-word, num-word and smart-mouse
#define DSK_PREV &hmr LCTRL LG(LC(LEFT)) // previous desktop
#define DSK_NEXT &hmr LCMD LG(LC(RIGHT)) // next     desktop
#define PIN_WIN &kp LG(LC(LS(Q)))        // pin window across desktops
#define PIN_APP &kp LG(LC(LS(A)))        // pin application across desktops
#define DSK_MGR &kp LA(GRAVE)            // desktop manager
// #define VOL_DOWN    &hmr RSHFT C_VOL_DN // ! Me: Original vol up from urob.
// But don't need hmr and blocked repeat hit..
#define VOL_DOWN &kp C_VOL_DN
// #define VOL_UP      &hmr RCMD C_VOL_UP // ! Me: Original vol up from urob.
// But don't need hmr and blocked repeat hit..
#define VOL_UP &kp C_VOL_UP
#define LASSO_COPY &kp LG(LC(LS(N4)))

/* Keymap */

ZMK_CONDITIONAL_LAYER(sys, FN NUM, SYS) // FN + NUM --> SYS

// ME: BE AWARE the layer name e.g. `base, num, ...`
ZMK_LAYER(
    base,
    // ╭──────╮
    // ╭─────────────┬─────────────┬─────────────┬─────────────┬─────────────╮
    // ╭──────╮
    // ╭─────────────┬─────────────┬─────────────┬─────────────┬─────────────╮
    // ╭──────╮
    X_LT &kp Q &kp W &kp F &kp P &kp B X_MT &kp J &kp L &kp U &kp Y &kp SQT X_RT
        // ├──────┤
        // ├─────────────┼─────────────┼─────────────┼─────────────┼─────────────┤
        // ├──────┤
        // ├─────────────┼─────────────┼─────────────┼─────────────┼─────────────┤
        // ├──────┤
        X_LM &hml LCMD A &hml LALT R &hml LSHFT S &hml LCTRL T &kp
            G X_MM &kp M &hmr LCTRL N &hmr RSHFT E &hmr LALT I &hmr LCMD O X_RM
        // ├──────┤
        // ├─────────────┼─────────────┼─────────────┼─────────────┼─────────────┤
        // ├──────┤
        // ├─────────────┼─────────────┼─────────────┼─────────────┼─────────────┤
        // ├──────┤
        X_LB &kp Z &kp X &kp C &kp D &kp V X_MB &kp K &kp H &comma_morph &
        dot_morph &
        qexcl X_RB
        // ├──────┤
        // ╰─────────────┼─────────────┴─────────────┼─────────────┼─────────────┤
        // ├──────┤
        // ├─────────────┼─────────────┼─────────────┴───────────────────────────╯
        // ├──────┤
        X_LH &
        lt_spc NAV 0 & lt FN RET X_MH SMART_NUM & smart_shft X_RH
    // ╰──────╯ ╰─────────────┴─────────────╯ ╰──────╯
    // ╰─────────────┴─────────────╯ ╰──────╯
)

ZMK_LAYER(
    nav,
    // ╭──────╮
    // ╭─────────────┬─────────────┬─────────────┬─────────────┬─────────────╮
    // ╭──────╮
    // ╭─────────────┬─────────────┬─────────────┬─────────────┬─────────────╮
    // ╭──────╮
    X_LT ___ ___ &kp LS(TAB) & swapper ___ X_MT &
        kp PG_UP NAV_BSPC NAV_UP NAV_DEL ___ X_RT
        // ├──────┤
        // ├─────────────┼─────────────┼─────────────┼─────────────┼─────────────┤
        // ├──────┤
        // ├─────────────┼─────────────┼─────────────┼─────────────┼─────────────┤
        // ├──────┤
        X_LM &
        sk LGUI & sk LALT & sk LSHFT & sk LCTRL ___ X_MM &
        kp PG_DN NAV_LEFT NAV_DOWN NAV_RIGHT &
        kp RET X_RM
            // ├──────┤
            // ├─────────────┼─────────────┼─────────────┼─────────────┼─────────────┤
            // ├──────┤
            // ├─────────────┼─────────────┼─────────────┼─────────────┼─────────────┤
            // ├──────┤
            X_LB ___ ___ ___ ___ ___ X_MB &
        kp INS &
        kp TAB ___ ___ ___ X_RB
            // ├──────┤
            // ╰─────────────┼─────────────┴─────────────┼─────────────┼─────────────┤
            // ├──────┤
            // ├─────────────┼─────────────┼─────────────┴───────────────────────────╯
            // ├──────┤
            X_LH ___ ___ X_MH ___ CANCEL X_RH
    // ╰──────╯ ╰─────────────┴─────────────╯ ╰──────╯
    // ╰─────────────┴─────────────╯ ╰──────╯
)

// BE AWARE: originally the `&win_sleep` was used at position RB4 to hit sleep
// on windows. But om mac the `C_POWER` is used for sleep.
ZMK_LAYER(
    fn,
    // ╭──────╮
    // ╭─────────────┬─────────────┬─────────────┬─────────────┬─────────────╮
    // ╭──────╮
    // ╭─────────────┬─────────────┬─────────────┬─────────────┬─────────────╮
    // ╭──────╮
    X_LT &kp F12 &kp F7 &kp F8 &kp F9 ___
        X_MT ___ &kp C_PREV &kp C_BRI_DN &kp C_BRI_UP &kp C_NEXT X_RT
    // ├──────┤
    // ├─────────────┼─────────────┼─────────────┼─────────────┼─────────────┤
    // ├──────┤
    // ├─────────────┼─────────────┼─────────────┼─────────────┼─────────────┤
    // ├──────┤
    X_LM &hml LCMD F11 &hml LALT F1 &hml LSHFT F2 &hml LCTRL F3 ___ X_MM ___
        DSK_PREV VOL_DOWN VOL_UP DSK_NEXT X_RM
    // ├──────┤
    // ├─────────────┼─────────────┼─────────────┼─────────────┼─────────────┤
    // ├──────┤
    // ├─────────────┼─────────────┼─────────────┼─────────────┼─────────────┤
    // ├──────┤
    X_LB &kp F10 &kp F4 &kp F5 &kp F6 ___ X_MB PIN_APP PIN_WIN DSK_MGR ___ &kp
        C_POWER X_RB
            // ├──────┤
            // ╰─────────────┼─────────────┴─────────────┼─────────────┼─────────────┤
            // ├──────┤
            // ├─────────────┼─────────────┼─────────────┴───────────────────────────╯
            // ├──────┤
            X_LH ___ ___ X_MH &kp C_MUTE &kp C_PP X_RH
    // ╰──────╯ ╰─────────────┴─────────────╯ ╰──────╯
    // ╰─────────────┴─────────────╯ ╰──────╯
)

ZMK_LAYER(
    num,
    // ╭──────╮
    // ╭─────────────┬─────────────┬─────────────┬─────────────┬─────────────╮
    // ╭──────╮
    // ╭─────────────┬─────────────┬─────────────┬─────────────┬─────────────╮
    // ╭──────╮
    X_LT ___ &kp N7 &kp N8 &kp N9 ___ X_MT ___ ___ ___ ___ ___ X_RT
    // ├──────┤
    // ├─────────────┼─────────────┼─────────────┼─────────────┼─────────────┤
    // ├──────┤
    // ├─────────────┼─────────────┼─────────────┼─────────────┼─────────────┤
    // ├──────┤
    X_LM &hml LCMD N0 &hml LCMD N1 &hml LSHFT N2 &hml LCTRL N3 ___ X_MM ___ ___
        ___ ___ ___ X_RM
            // ├──────┤
            // ├─────────────┼─────────────┼─────────────┼─────────────┼─────────────┤
            // ├──────┤
            // ├─────────────┼─────────────┼─────────────┼─────────────┼─────────────┤
            // ├──────┤
            X_LB ___ &kp N4 &kp N5 &kp N6 ___ X_MB ___ ___ ___ ___ ___ X_RB
                // ├──────┤
                // ╰─────────────┼─────────────┴─────────────┼─────────────┼─────────────┤
                // ├──────┤
                // ├─────────────┼─────────────┼─────────────┴───────────────────────────╯
                // ├──────┤
                X_LH ___ ___ X_MH ___ ___ X_RH
    // ╰──────╯ ╰─────────────┴─────────────╯ ╰──────╯
    // ╰─────────────┴─────────────╯ ╰──────╯
)

ZMK_LAYER(
    sys,
    // ╭──────╮
    // ╭─────────────┬─────────────┬─────────────┬─────────────┬─────────────╮
    // ╭──────╮
    // ╭─────────────┬─────────────┬─────────────┬─────────────┬─────────────╮
    // ╭──────╮
    X_LT _BT_SEL_KEYS_ X_MT ___ ___ ___ ___ ___ X_RT
        // ├──────┤
        // ├─────────────┼─────────────┼─────────────┼─────────────┼─────────────┤
        // ├──────┤
        // ├─────────────┼─────────────┼─────────────┼─────────────┼─────────────┤
        // ├──────┤
        X_LM ___ ___ ___ ___ &bootloader X_MM &bootloader ___ ___ ___ ___ X_RM
            // ├──────┤
            // ├─────────────┼─────────────┼─────────────┼─────────────┼─────────────┤
            // ├──────┤
            // ├─────────────┼─────────────┼─────────────┼─────────────┼─────────────┤
            // ├──────┤
            X_LB ___ ___ ___ ___ &sys_reset X_MB &sys_reset ___ ___ ___ ___ X_RB
                // ├──────┤
                // ╰─────────────┼─────────────┴─────────────┼─────────────┼─────────────┤
                // ├──────┤
                // ├─────────────┼─────────────┼─────────────┴───────────────────────────╯
                // ├──────┤
                X_LH ___ ___ X_MH ___ ___ X_RH
    // ╰──────╯ ╰─────────────┴─────────────╯ ╰──────╯
    // ╰─────────────┴─────────────╯ ╰──────╯
)

ZMK_LAYER(
    uc,
    // ╭──────╮
    // ╭─────────────┬─────────────┬─────────────┬─────────────┬─────────────╮
    // ╭──────╮
    // ╭─────────────┬─────────────┬─────────────┬─────────────┬─────────────╮
    // ╭──────╮
    X_LT ___ &el_omega & el_phi & el_pi & el_beta X_MT ___ & el_lambda &
        el_upsilon & el_psi &
        de_eszett X_RT
        // ├──────┤
        // ├─────────────┼─────────────┼─────────────┼─────────────┼─────────────┤
        // ├──────┤
        // ├─────────────┼─────────────┼─────────────┼─────────────┼─────────────┤
        // ├──────┤
        X_LM &
        el_alpha & el_rho & el_sigma & el_tau & el_gamma X_MM & el_mu & el_nu &
        el_epsilon & el_iota &
        el_omikron X_RM
        // ├──────┤
        // ├─────────────┼─────────────┼─────────────┼─────────────┼─────────────┤
        // ├──────┤
        // ├─────────────┼─────────────┼─────────────┼─────────────┼─────────────┤
        // ├──────┤
        X_LB &
        el_zeta & el_xi & el_chi & el_delta & el_theta X_MB & el_kappa &
        el_eta & de_ae & de_oe &
        de_ue X_RB
            // ├──────┤
            // ╰─────────────┼─────────────┴─────────────┼─────────────┼─────────────┤
            // ├──────┤
            // ├─────────────┼─────────────┼─────────────┴───────────────────────────╯
            // ├──────┤
            X_LH ___ ___ X_MH ___ ___ X_RH
    // ╰──────╯ ╰─────────────┴─────────────╯ ╰──────╯
    // ╰───────────────────────────╯ ╰──────╯
)

ZMK_LAYER(
    mouse,
    // ╭──────╮
    // ╭─────────────┬─────────────┬─────────────┬─────────────┬─────────────╮
    // ╭──────╮
    // ╭─────────────┬─────────────┬─────────────┬─────────────┬─────────────╮
    // ╭──────╮
    X_LT ___ ___ ___ ___ ___ X_MT U_WH_L U_WH_D U_MS_U U_WH_U U_WH_R X_RT
        // ├──────┤
        // ├─────────────┼─────────────┼─────────────┼─────────────┼─────────────┤
        // ├──────┤
        // ├─────────────┼─────────────┼─────────────┼─────────────┼─────────────┤
        // ├──────┤
        X_LM ___ ___ ___ ___ ___ X_MM ___ U_MS_L U_MS_D U_MS_R ___ X_RM
            // ├──────┤
            // ├─────────────┼─────────────┼─────────────┼─────────────┼─────────────┤
            // ├──────┤
            // ├─────────────┼─────────────┼─────────────┼─────────────┼─────────────┤
            // ├──────┤
            X_LB ___ ___ ___ ___ ___ X_MB ___ &mkp MB4 &mkp MCLK &mkp MB5 ___ X_RB
                // ├──────┤
                // ╰─────────────┼─────────────┴─────────────┼─────────────┼─────────────┤
                // ├──────┤
                // ├─────────────┼─────────────┼─────────────┴───────────────────────────╯
                // ├──────┤
                X_LH ___ ___ X_MH &mkp LCLK &mkp RCLK X_RH
    // ╰──────╯ ╰─────────────┴─────────────╯ ╰──────╯
    // ╰─────────────┴─────────────╯ ╰──────╯
)

/* vim: set ft=c tw=174: */
